## boards/shields/eva_oled/Kconfig.defconfig
```kconfig
# EVA OLED - Evangelion themed status screen for 128x32 SSD1306 (Corne)
# SPDX-License-Identifier: MIT

if SHIELD_EVA_OLED

config EVA_OLED_FRAME_MS
    int "EVA OLED frame period in ms"
    default 80

config EVA_OLED_FLIP
    bool "Rotate the EVA screen by 180 degrees"
    default n

config EVA_OLED_INVERT
    bool "Swap lit/unlit pixels (use if the screen shows a negative image)"
    default n

config ZMK_DISPLAY
    default y

choice ZMK_DISPLAY_STATUS_SCREEN
    default ZMK_DISPLAY_STATUS_SCREEN_CUSTOM
endchoice

choice ZMK_DISPLAY_WORK_QUEUE
    default ZMK_DISPLAY_WORK_QUEUE_DEDICATED
endchoice

config LV_Z_BITS_PER_PIXEL
    default 1

choice LV_COLOR_DEPTH
    default LV_COLOR_DEPTH_1
endchoice

config LV_Z_MEM_POOL_SIZE
    default 4096

if !ZMK_SPLIT || ZMK_SPLIT_ROLE_CENTRAL

config ZMK_WPM
    default y

config ZMK_HID_INDICATORS
    default y

endif

endif # SHIELD_EVA_OLED
```

## config/west.yml
```yaml
manifest:
  remotes:
    - name: zmkfirmware
      url-base: https://github.com/zmkfirmware
    # nice_view_gem
    - name: m165437
      url-base: https://github.com/M165437
    # dongle_display
    - name: englmaxi
      url-base: https://github.com/englmaxi
    # nice_oled
    - name: mctechnology17
      url-base: https://github.com/mctechnology17
  projects:
    - name: zmk
      remote: zmkfirmware
      revision: v0.3 # fixado: main migrou p/ Zephyr 4.1 em 12/2025 e quebrou o build
      import: app/west.yml
    # nice_view_gem
    - name: nice-view-gem
      remote: m165437
      revision: 7794ebf7f75d7e16cb05240bcffe6c5a45ef5b44 # ultimo commit compativel com zmk v0.3
    # dongle_display
    - name: zmk-dongle-display
      remote: englmaxi
      revision: c6c4be11c5ede722086a2a1f355cec9c101b9390 # ultimo commit compativel com zmk v0.3
    # nice_oled
    - name: zmk-nice-oled
      remote: mctechnology17
      revision: 5d7dce25735277dd6dcd8295c64e143d4f95cdfa # ultimo commit compativel com zmk v0.3
  self:
    path: config
```
